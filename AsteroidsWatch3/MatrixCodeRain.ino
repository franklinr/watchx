
static const unsigned char PROGMEM logo16_glcd_bmp[] =
{
  B00000000, B00000000,
  B00000011, B11000000,
  B00001111, B11110000,
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  B00000000, B00000000,
};

char columnpos[] = {30, 50, -20, 0, 30, 20, 40 };
char offset = 0;

void drawNum(int d, int col, int fin, int c) {
  int dones = d % 10;
  int dtens = (d / 10) % 10;
  if (d > 99) {
    dtens = 9;
    dones = 9;
  }
  if (dtens == 0) {
    display.drawBitmap(col, offset + columnpos[c] + 0,  &logo16_glcd_bmp[16 * 2 * dones + 2], 16, 16, 1);
    display.drawBitmap(col, offset + columnpos[c] + 16,  &logo16_glcd_bmp[16 * 2 * fin + 2], 16, 16, 1);
  } else {
    if (dtens == 1) {
      if (dones == 0) {
        display.drawBitmap(col, offset + columnpos[c] + 0,  &logo16_glcd_bmp[16 * 2 * 10 + 2], 16, 16, 1);
        display.drawBitmap(col, offset + columnpos[c] + 16,  &logo16_glcd_bmp[16 * 2 * fin + 2], 16, 16, 1);
      } else {
        display.drawBitmap(col, offset + columnpos[c] + 0,  &logo16_glcd_bmp[16 * 2 * 10 + 2], 16, 16, 1);
        display.drawBitmap(col, offset + columnpos[c] + 16,  &logo16_glcd_bmp[16 * 2 * dones + 2], 16, 16, 1);
        display.drawBitmap(col, offset + columnpos[c] + 32,  &logo16_glcd_bmp[16 * 2 * fin + 2], 16, 16, 1);
      }
    } else {
      if (dones == 0) {
        display.drawBitmap(col, offset + columnpos[c] + 0,  &logo16_glcd_bmp[16 * 2 * dtens + 2], 16, 16, 1);
        display.drawBitmap(col, offset + columnpos[c] + 16,  &logo16_glcd_bmp[16 * 2 * 10 + 2], 16, 16, 1);
        display.drawBitmap(col, offset + columnpos[c] + 32,  &logo16_glcd_bmp[16 * 2 * fin + 2], 16, 16, 1);
      } else {
        display.drawBitmap(col, offset + columnpos[c] + 0,  &logo16_glcd_bmp[16 * 2 * dtens + 2], 16, 16, 1);
        display.drawBitmap(col, offset + columnpos[c] + 16,  &logo16_glcd_bmp[16 * 2 * 10 + 2], 16, 16, 1);
        display.drawBitmap(col, offset + columnpos[c] + 32,  &logo16_glcd_bmp[16 * 2 * dones + 2], 16, 16, 1);
        display.drawBitmap(col, offset + columnpos[c] + 48,  &logo16_glcd_bmp[16 * 2 * fin + 2], 16, 16, 1);
      }
    }
  }
  if (offset == 0) {
    offset = -64;
    drawNum(d, col, fin, c);
    offset = 0;
  }
}


void showBatteryJapanese() {
  //batteryLevel = getBatteryPercent();
  display.drawBitmap(18, columnpos[1] + 0,  &logo16_glcd_bmp[16 * 2 * 16 + 2  ], 16, 16, 1);
  display.drawBitmap(18, columnpos[1] + 16,  &logo16_glcd_bmp[16 * 2 * 17 + 2], 16, 16, 1);
  drawNum(batteryLevel * 100, 0, 18, 0);

  display.drawBitmap(18, -64 + columnpos[1] + 0,  &logo16_glcd_bmp[16 * 2 * 16 + 2  ], 16, 16, 1);
  display.drawBitmap(18, -64 + columnpos[1] + 16,  &logo16_glcd_bmp[16 * 2 * 17 + 2], 16, 16, 1);
}


void showTimeJapanese() {
  display.setCursor(0, 0);
  now  = rtc.now();
  drawNum(now.year(), 108, 13, 6);
  drawNum(now.month(), 90, 14, 5);
  drawNum(now.day(), 72, 15, 4);

  drawNum(now.hour(), 54, 11, 3);
  drawNum(now.minute(), 36, 12, 2);
}

void drawJapanese() {
  for (int i = 0; i < 7; i++) {
    columnpos[i] = columnpos[i] + random(0, 4);
    if (columnpos[i] > 64) {
      columnpos[i] = 0;
    }
  }
  showTimeJapanese();
  showBatteryJapanese();
  sleepMillis(125);
}
